/*
 * splitkb Aurora Corne (halves connect to a computer, left half is central).
 * Layout: splitkb_aurora_corne_layout.dtsi. Layers: keymap.dtsi.
 */

#include "leds_nice_nano_rgb.dtsi"

&nice_view_spi {
    cs-gpios = <&pro_micro 0 GPIO_ACTIVE_HIGH>;
};

#include "splitkb_aurora_corne_layout.dtsi"
#include "keymap.dtsi"
#include "half_status.dtsi"
