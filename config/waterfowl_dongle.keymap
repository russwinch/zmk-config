/*
 * Waterfowl via a Prospector dongle: the dongle is the central and runs
 * this keymap; both halves are peripherals. Same layers as waterfowl.keymap.
 * Layout: waterfowl_layout.dtsi. Layers: keymap.dtsi.
 */

// The battery key (&ind_bat) still works from here: the dongle has the widget
// turned off (prospector_adapter.conf), but ZMK passes the key on to both halves,
// which each blink their own battery level on their LED.

#include "waterfowl_layout.dtsi"
#include "keymap.dtsi"
