/*
 * Urchin (halves connect to a computer, left half is central).
 * Layout: urchin_layout.dtsi. Layers: keymap.dtsi.
 */

#include "leds_nice_nano_rgb.dtsi"
#include "urchin_layout.dtsi"
#include "keymap.dtsi"
#include "half_status.dtsi"
