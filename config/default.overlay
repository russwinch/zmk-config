/*
 * Devicetree for every build (all keyboards, the dongle, settings_reset).
 *
 * ZMK only reads this when config/ has no overlay named after the shield or
 * board, so if one of those is ever added, #include this file from it.
 */

/* USB serial port for the Keyboard Writer app (keyboard-writer module). */
#include <keyboard_writer.dtsi>
