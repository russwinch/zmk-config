/*
 * Waterfowl (halves connect to a computer, left half is central).
 * Layout: waterfowl_layout.dtsi. Layers: keymap.dtsi.
 */

#include "leds_nice_nano_rgb.dtsi"
#include "waterfowl_layout.dtsi"
#include "keymap.dtsi"
#include "half_status.dtsi"
