/*
 * Touch on the Prospector dongle's screen (src/dongle_screen_fx.c).
 *
 * The Waveshare 1.69" touch panel has a CST816 touch controller on four
 * wires that the Prospector assembly manual says to cut. Connected to the
 * XIAO like this, it works:
 *
 *   TP_SDA -> D4 (SDA)    TP_SCL -> D5 (SCL)
 *   TP_IRQ -> D0          TP_RST -> D1
 *
 * The same wiring as the Prospector Scanner firmware's touch mode
 * (t-ogura/zmk-config-prospector, docs/TOUCH_MODE.md), so that firmware can
 * be used to check the soldering. D4/D5 are shared with the optional light
 * sensor, which is at another address.
 *
 * Harmless when the wires aren't connected: the controller isn't found at
 * start-up and nothing else changes.
 */

#include <dt-bindings/gpio/gpio.h>

/* the XIAO's own pull-ups, in case the panel's board has none on these lines */
&i2c1_default {
    group1 {
        bias-pull-up;
    };
};

&i2c1 {
    status = "okay";

    prospector_touch: cst816s@15 {
        compatible = "hynitron,cst816s";
        reg = <0x15>;
        irq-gpios = <&xiao_d 0 (GPIO_ACTIVE_LOW | GPIO_PULL_UP)>;
        rst-gpios = <&xiao_d 1 GPIO_ACTIVE_LOW>;
    };
};
