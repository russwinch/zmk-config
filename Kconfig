## Kconfig
```kconfig
# Options for this repo's own code (see CMakeLists.txt).

config WATERFOWL_DONGLE_IDLE_BACKLIGHT
    bool "Dim, then switch off, the Prospector screen backlight when idle"
    default y
    depends on SHIELD_WATERFOWL_DONGLE || SHIELD_URCHIN_DONGLE || SHIELD_SPLITKB_AURORA_CORNE_DONGLE || SHIELD_FORAGER_DONGLE
    depends on ZMK_DISPLAY && !PROSPECTOR_USE_AMBIENT_LIGHT_SENSOR
    help
      After CONFIG_ZMK_IDLE_TIMEOUT without a key press the backlight fades to
      WATERFOWL_DONGLE_IDLE_BRIGHTNESS; after a further
      WATERFOWL_DONGLE_BACKLIGHT_OFF_MS it goes off. Any key or encoder fades
      it back up to the brightness chosen (WATERFOWL_DONGLE_BRIGHTNESS_LOW). With DONGLE_SCREEN_FX
      it also stays dark at power-up until the first picture is ready.

if WATERFOWL_DONGLE_IDLE_BACKLIGHT

config WATERFOWL_DONGLE_IDLE_BRIGHTNESS
    int "Backlight brightness (%) while idle"
    default 0
    range 0 100
    help
      0 also switches the panel off (display blanking). The backlight PWM
      keeps running at its shortest pulse rather than being stopped (see
      src/dongle_idle_backlight.c).

config WATERFOWL_DONGLE_BRIGHTNESS_LOW
    int "Backlight brightness (%) at the low level"
    default 20
    range 1 100
    help
      The &scr_bright key steps the backlight through low, medium and high.
      Medium is CONFIG_PROSPECTOR_FIXED_BRIGHTNESS, and what a dongle has
      until another is chosen.

config WATERFOWL_DONGLE_BRIGHTNESS_HIGH
    int "Backlight brightness (%) at the high level"
    default 90
    range 1 100

config WATERFOWL_DONGLE_BACKLIGHT_OFF_MS
    int "Milliseconds after going idle before the backlight goes off (0 = never)"
    default 0

endif

# --- nice!view status on the left half, fed by the dongle (src/half_status.h) ---

config WATERFOWL_DONGLE_HALF_STATUS
    bool "Send the Bluetooth profile and battery levels to the halves"
    default y
    depends on SHIELD_WATERFOWL_DONGLE || SHIELD_SPLITKB_AURORA_CORNE_DONGLE
    depends on ZMK_SPLIT_ROLE_CENTRAL && ZMK_SPLIT_BLE_CENTRAL_BATTERY_LEVEL_FETCHING
    help
      Not the Forager's or Urchin's dongles: their halves have no display. The dongle tells each half the active profile (and which profiles are
      connected/paired), whether it is typing over USB, and the other half's
      battery. Used by WATERFOWL_HALF_STATUS_SCREEN on the left half.

config WATERFOWL_DONGLE_HALF_STATUS_REFRESH_S
    int "Seconds between repeat sends, as a catch-all"
    default 60
    depends on WATERFOWL_DONGLE_HALF_STATUS

config WATERFOWL_HALF_STATUS_SCREEN
    bool "nice!view screen for a left half: both batteries and the output"
    depends on SHIELD_NICE_VIEW && ZMK_DISPLAY && ZMK_SPLIT
    depends on !NICE_VIEW_WIDGET_STATUS
    imply ZMK_SPLIT_BLE_CENTRAL_BATTERY_LEVEL_FETCHING if ZMK_SPLIT_ROLE_CENTRAL
    select LV_USE_CANVAS
    select LV_FONT_MONTSERRAT_14
    select LV_FONT_MONTSERRAT_16
    select LV_FONT_MONTSERRAT_18
    select LV_FONT_MONTSERRAT_28
    select LV_FONT_MONTSERRAT_36
    help
      Replaces ZMK's stock nice!view screen with both batteries, big, and
      the output (USB, or the active Bluetooth profile). On its own the
      left half (the central) knows all of it; behind the dongle the dongle
      sends what the half can't know, to the half_status behavior node
      (config/half_status.dtsi). Needs NICE_VIEW_WIDGET_STATUS=n (the stock
      screen). Turned on for every left half with a nice!view in
      config/nice_view.conf.

# --- Whether each half is charging (src/half_charging.c, src/dongle_half_info.c) ---

config HALF_CHARGING_STATUS
    bool "Tell the dongle when this half is on USB power"
    default y
    depends on ZMK_SPLIT && !ZMK_SPLIT_ROLE_CENTRAL && USB_DEVICE_STACK && BT_BAS
    select BT_BAS_BLS
    help
      Every half that is a peripheral (so also each right half without a
      dongle, where nothing reads it). Sets the battery service's Battery
      Level Status to charging while on USB power, for the dongle's screens.

config DONGLE_HALF_INFO
    bool "Hear whether each half is on USB power"
    default y
    depends on SHIELD_PROSPECTOR_ADAPTER && ZMK_SPLIT_ROLE_CENTRAL && BT_GATT_CLIENT
    depends on BT_GATT_AUTO_DISCOVER_CCC && ZMK_SPLIT_BLE_CENTRAL_BATTERY_LEVEL_FETCHING
    help
      Read once a half is connected and ZMK is done setting it up, one
      request at a time, then subscribed to (the half sends only changes).
      The dongle's screens then show a bolt beside a charging half's level.

config BATTERY_REFRESH_ON_UNPLUG
    bool "Read the battery again a few seconds after USB power goes"
    default y
    depends on ZMK_BATTERY_REPORTING && USB_DEVICE_STACK
    help
      Every board with a battery (src/battery_refresh.c): otherwise the
      charger's near-100 reading stays up to ZMK_BATTERY_REPORT_INTERVAL.

# --- Animated screens on the dongle (src/dongle_screen_fx.c) ---

config DONGLE_SCREEN_FX
    bool "Typing-reactive animations as extra screens on the Prospector dongle"
    default y
    depends on SHIELD_PROSPECTOR_ADAPTER && ZMK_DISPLAY && ZMK_SPLIT_ROLE_CENTRAL
    depends on ZMK_SPLIT_BLE_CENTRAL_BATTERY_LEVEL_FETCHING
    select ZMK_WPM
    select HWINFO
    select SYS_HEAP_RUNTIME_STATS
    imply BT_CTLR_CONN_RSSI
    help
      The &scr_next key steps through the animations in
      src/screen_fx/fx.c (those that aren't screensavers) and round again;
      &scr_prev goes the other way, and &scr_theme steps through the colour
      themes of the Keys, Debug, Tracker and Terminal screens. Each shows both batteries and the
      connection. Before the animations come the Keys screen and a Debug
      screen of readings, for which this turns
      on the reset cause (HWINFO), LVGL's memory figures and, in the
      Bluetooth controller, signal strength. They take the place of the
      Prospector module's own status screen (DONGLE_SCREEN_FX_MODULE_SCREEN
      keeps it). Their pictures (about
      60 KB) live in LVGL's drawing buffers, which must be that big: the
      Prospector module's half-screen ones are.

if DONGLE_SCREEN_FX

config DONGLE_SCREEN_FX_MODULE_SCREEN
    bool "Keep the Prospector module's status screen among the screens"
    help
      It is then the first screen the keys step through, ahead of the
      animations, and shows for a moment at power-up whichever screen is
      chosen. Without this it is never shown.

config DONGLE_SCREEN_FX_START
    int "Screen shown after power-up, until one has been chosen"
    default 0
    range 0 5
    help
      Counted through the screens in the order &scr_next shows them: 0 the
      Keys screen, 1 the Debug screen, 2 Thermal, 3 Tracker, 4 Terminal.
      With DONGLE_SCREEN_FX_MODULE_SCREEN the module's screen
      is 0 and each of those one more.
      The screensavers aren't among them. Once a screen has been chosen with
      the keys it is saved (with CONFIG_SETTINGS) and shown instead; a
      settings reset brings this one back.

config DONGLE_SCREEN_FX_SAVE_DELAY_MS
    int "Milliseconds a chosen screen, colour theme or brightness must stay before it is saved"
    default 30000
    help
      Stepping through the screens, or the themes, doesn't write each one
      to flash, only the one that is left showing.

config DONGLE_SCREEN_FX_WPM_REFERENCE
    int "Words per minute at which the animations run flat out"
    default 60
    range 10 300

config DONGLE_SCREEN_FX_SAVER_MINUTES
    int "Minutes without a key before the screensaver comes on (0 = never)"
    default 15
    range 0 1440
    help
      One of the screensaver animations (Warp, Code, Life), picked at
      random, takes over from whichever screen is showing, and the
      first key starts that screen on its way back. Letting go of the
      Config layer's lock key (Ctrl+Cmd+Q) starts it at once. It only shows while
      the panel is on: keep this under ZMK_IDLE_TIMEOUT. When the panel does
      go off the picture closes to a dot first, and it comes back through
      static.

endif

config BEHAVIOR_APP_SWITCH
    bool
    default y
    depends on DT_HAS_ZMK_BEHAVIOR_APP_SWITCH_ENABLED
    # it works the keymap's layers, which only the central has
    depends on !ZMK_SPLIT || ZMK_SPLIT_ROLE_CENTRAL

config BEHAVIOR_SCREEN_NEXT
    bool
    default y
    depends on DT_HAS_ZMK_BEHAVIOR_SCREEN_NEXT_ENABLED

config BEHAVIOR_WHEEL
    bool
    default y
    depends on DT_HAS_ZMK_BEHAVIOR_WHEEL_ENABLED
    # the mouse report it sends, which only the central has
    depends on ZMK_POINTING && (!ZMK_SPLIT || ZMK_SPLIT_ROLE_CENTRAL)
```
