## Kconfig
```kconfig
# Options for this repo's own code (see CMakeLists.txt).

config WATERFOWL_DONGLE_IDLE_BACKLIGHT
    bool "Dim, then switch off, the Prospector screen backlight when idle"
    default y
    depends on SHIELD_WATERFOWL_DONGLE || SHIELD_URCHIN_DONGLE || SHIELD_SPLITKB_AURORA_CORNE_DONGLE || SHIELD_FORAGER_DONGLE
    depends on ZMK_DISPLAY && !PROSPECTOR_USE_AMBIENT_LIGHT_SENSOR
    help
      After CONFIG_ZMK_IDLE_TIMEOUT without a key press the backlight drops to
      WATERFOWL_DONGLE_IDLE_BRIGHTNESS; after a further
      WATERFOWL_DONGLE_BACKLIGHT_OFF_MS it goes off. Any key or encoder brings
      it back to CONFIG_PROSPECTOR_FIXED_BRIGHTNESS.

if WATERFOWL_DONGLE_IDLE_BACKLIGHT

config WATERFOWL_DONGLE_IDLE_BRIGHTNESS
    int "Backlight brightness (%) while idle"
    default 0
    range 0 100
    help
      0 also switches the panel off (display blanking). The backlight PWM
      keeps running at its shortest pulse rather than being stopped (see
      src/dongle_idle_backlight.c).

config WATERFOWL_DONGLE_BACKLIGHT_OFF_MS
    int "Milliseconds after going idle before the backlight goes off (0 = never)"
    default 0

endif

# --- nice!view status on the left half, fed by the dongle (src/half_status.h) ---

config WATERFOWL_DONGLE_HALF_STATUS
    bool "Send the Bluetooth profile and battery levels to the halves"
    default y
    depends on SHIELD_WATERFOWL_DONGLE && ZMK_SPLIT_ROLE_CENTRAL && ZMK_SPLIT_BLE_CENTRAL_BATTERY_LEVEL_FETCHING
    help
      The dongle tells each half the active profile (and which profiles are
      connected/paired), whether it is typing over USB, and the other half's
      battery. Used by WATERFOWL_HALF_STATUS_SCREEN on the left half.

config WATERFOWL_DONGLE_HALF_STATUS_REFRESH_S
    int "Seconds between repeat sends, as a catch-all"
    default 60
    depends on WATERFOWL_DONGLE_HALF_STATUS

config WATERFOWL_HALF_STATUS_SCREEN
    bool "nice!view screen for a Waterfowl half behind the dongle"
    depends on SHIELD_NICE_VIEW && ZMK_DISPLAY && ZMK_SPLIT && !ZMK_SPLIT_ROLE_CENTRAL
    depends on !NICE_VIEW_WIDGET_STATUS
    select LV_USE_CANVAS
    select LV_FONT_MONTSERRAT_14
    select LV_FONT_MONTSERRAT_16
    select LV_FONT_MONTSERRAT_18
    select LV_FONT_UNSCII_8
    help
      Replaces ZMK's stock peripheral screen with both batteries and the
      dongle's Bluetooth profile. Needs NICE_VIEW_WIDGET_STATUS=n (the stock
      screen) and the half_status behavior node (config/waterfowl.keymap).
      Turned on for the dongle build of the left half in build.yaml.

# --- Animated screens on the dongle (src/dongle_screen_fx.c) ---

config DONGLE_SCREEN_FX
    bool "Typing-reactive animations as extra screens on the Prospector dongle"
    default y
    depends on SHIELD_PROSPECTOR_ADAPTER && ZMK_DISPLAY && ZMK_SPLIT_ROLE_CENTRAL
    depends on ZMK_SPLIT_BLE_CENTRAL_BATTERY_LEVEL_FETCHING
    select ZMK_WPM
    help
      The &scr_next key steps from the Prospector module's status screen
      through the animations in src/screen_fx/fx.c and back. Each shows both
      batteries and the connection along the bottom. Their pictures (about
      60 KB) live in LVGL's drawing buffers, which must be that big: the
      Prospector module's half-screen ones are.

if DONGLE_SCREEN_FX

config DONGLE_SCREEN_FX_START
    int "Screen shown after power-up"
    default 0
    range 0 3
    help
      0 is the Prospector module's status screen; 1 and up are the
      animations, in the order &scr_next shows them (Warp, Fire,
      Sparks).

config DONGLE_SCREEN_FX_WPM_REFERENCE
    int "Words per minute at which the animations run flat out"
    default 60
    range 10 300

endif

config BEHAVIOR_SCREEN_NEXT
    bool
    default y
    depends on DT_HAS_ZMK_BEHAVIOR_SCREEN_NEXT_ENABLED
```

## boards/shields/waterfowl_dongle/Kconfig.shield
```kconfig
config SHIELD_WATERFOWL_DONGLE
    def_bool $(shields_list_contains,waterfowl_dongle)
```
